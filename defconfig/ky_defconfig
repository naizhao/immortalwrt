## defconfig/ky_defconfig
```kconfig
CONFIG_TARGET_ky=y
CONFIG_TARGET_ky_riscv64=y
CONFIG_TARGET_ky_riscv64_DEVICE_x1_orangepi-rv2=y
CONFIG_TARGET_KERNEL_PARTSIZE=100
CONFIG_TARGET_ROOTFS_PARTSIZE=400

CONFIG_PACKAGE_openssh-sftp-server=y
CONFIG_PACKAGE_wpa-supplicant=y
CONFIG_PACKAGE_hostapd=y
CONFIG_PACKAGE_kmod-brcmfmac=y
CONFIG_BRCMFMAC_SDIO=y
# CONFIG_BRCMFMAC_USB is not set
# CONFIG_BRCMFMAC_PCIE is not set
CONFIG_PACKAGE_brcmfmac-firmware=y

CONFIG_PACKAGE_luci-app-openclash=y
CONFIG_PACKAGE_luci-app-passwall=y
# CONFIG_PACKAGE_luci-app-ssr-plus is not set
# CONFIG_PACKAGE_dnsmasq is not set
```
